## conf/distro/acme-baylibre.conf
```bitbake
require conf/distro/poky.conf

DISTRO = "acme-baylibre"
DISTROOVERRIDES = "poky"

VIRTUAL-RUNTIME_init_manager = "systemd"
VIRTUAL-RUNTIME_initscripts = ""

DISTRO_FEATURES_append = " systemd"
DISTRO_FEATURES_BACKFILL_CONSIDERED = "sysvinit"
```

## conf/layer.conf
```bitbake
# We have a conf and classes directory, add to BBPATH
BBPATH .= ":${LAYERDIR}:${LAYERDIR}/common"

# We have a recipes directory, add to BBFILES
BBFILES += "${LAYERDIR}/common/recipes-*/*/*.bb \
	${LAYERDIR}/common/recipes-*/*/*.bbappend"

BBFILE_COLLECTIONS += "baylibre"
BBFILE_PATTERN_baylibre := "^${LAYERDIR}/"
BBFILE_PRIORITY_baylibre = "6"
```

## meta-baylibre-acme/beaglebone.wks
```
# short-description: Create SD card image with a boot partition
# long-description: Creates a partitioned SD card image. Boot files
# are located in the first vfat partition.


part MLO --source rawcopy --sourceparams="file=MLO" --ondisk mmcblk --no-table --align 128
part uboot --source rawcopy --sourceparams="file=u-boot.img" --ondisk mmcblk --no-table --align 128
part uenv --source rawcopy --sourceparams="file=uEnv.txt" --ondisk mmcblk --no-table --align 128

#part /boot --source bootimg-partition --ondisk mmcblk --fstype=vfat --label boot --active --align 4 --size 16
part / --source rootfs --ondisk mmcblk --fstype=ext2 --label root 
```

## meta-baylibre-acme/conf/distro/acme-baylibre.conf
```bitbake
require conf/distro/poky.conf

# to build older u-boot or kernels
GCCVERSION = "4.9%"

DISTRO_TYPE = "release"

DISTRO = "acme-baylibre"
DISTROOVERRIDES = "poky"

hostname_pn-base-files = "baylibre-acme"

IMAGE_FSTYPES += " ext3"

EXTRA_IMAGE_FEATURES =+ " ssh-server-openssh"

VIRTUAL-RUNTIME_init_manager = "systemd"
VIRTUAL-RUNTIME_initscripts = ""

DISTRO_FEATURES_DEFAULT = "ext2 usbgadget usbhost systemd"
DISTRO_FEATURES_BACKFILL_CONSIDERED = "sysvinit"
```

## meta-baylibre-acme/conf/machine/beaglebone-acme.conf
```bitbake
require conf/machine/beaglebone.conf

MACHINE_FEATURES = "usbgadget usbhost"

SERIAL_CONSOLES = "115200;ttyO0 115200;ttyGS0 115200;ttyGS1"

PREFERRED_PROVIDER_virtual/kernel = "linux-yocto-mainline"
PREFERRED_PROVIDER_u-boot = "u-boot"
PREFERRED_VERSION_u-boot = "v2016.03+gitAUTOINC+df61a74e68"
```

## meta-baylibre-acme/conf/machine/raspberrypi0.conf
```bitbake
#@TYPE: Machine
#@NAME: RaspberryPi Zero Development Board
#@DESCRIPTION: Machine configuration for the RaspberryPi Zero board (https://www.raspberrypi.org/blog/raspberry-pi-zero)

MACHINEOVERRIDES = "raspberrypi:${MACHINE}"
include conf/machine/raspberrypi.conf

KERNEL_DEVICETREE_append = "overlays/dwc2-overlay.dtb \
"

SERIAL_CONSOLE = "115200 ttyAMA0"
```
